## sato-sdk-chromium-A/conf/bblayers.conf
```bitbake
# POKY_BBLAYERS_CONF_VERSION is increased each time build/conf/bblayers.conf
# changes incompatibly
POKY_BBLAYERS_CONF_VERSION = "2"

BBPATH = "${TOPDIR}"
BBFILES ?= ""

BBLAYERS ?= " \
  /home/michael/MoySandbox/yocto/poky/meta \
  /home/michael/MoySandbox/yocto/poky/meta-poky \
  /home/michael/MoySandbox/yocto/poky/meta-yocto-bsp \
  /home/michael/MoySandbox/yocto/poky/meta-python2 \
  /home/michael/MoySandbox/yocto/poky/meta-openembedded/meta-oe \
  /home/michael/MoySandbox/yocto/poky/meta-openembedded/meta-python \
  /home/michael/MoySandbox/yocto/poky/meta-clang \
  /home/michael/MoySandbox/yocto/poky/meta-browser \
  "
```
